## board/spreadtrum/ums512_1h10/Kconfig
```kconfig
if TARGET_UMS512_1H10

config RG_ROTATE
	bool "Build for RG Rotate"
	default n

config RG405M
	bool "Build for Anbernic RG405M"
	default n

config SYS_BOARD
	default "ums512_1h10"

config SYS_VENDOR
	default "spreadtrum"

config SYS_SOC
	default "sharkl5pro"

config SYS_CONFIG_NAME
	default "ums512_rg_rotate" if RG_ROTATE
	default "ums512_rg405m" if RG405M
	default "ums512_1h10"

config SYS_TEXT_BASE
	default 0x9f000000

endif
```
